/*
 * Device tree overlay for QuadOCDectCape.
 * Robert Heller D/B/A Deepwoods Software
 * June 30, 2019
 */

/dts-v1/;
/plugin/;

#include <dt-bindings/board/am335x-bbw-bbb-base.h>
#include <dt-bindings/gpio/gpio.h>
#include <dt-bindings/pinctrl/am33xx.h>

/ {
    compatible = "ti,beaglebone-black";

    /* identification */
    part-number = "BBB-QuadOCDect";

    /* version */
    version = "0001";

    exclusive-use =
        "P8.5",     /* OD2 */
        "P8.6",     /* OD3 */
        "P8.11",    /* OD4 */
        "P8.12";    /* OD1 */

    fragment@0 {
          target = <&am33xx_pinmux>;
          __overlay__ {
            /****************************************
            *                       pinmux helper
            ****************************************/
            mux_helper_pins: pins {
                    pinctrl-single,pins = <
                        BONE_P8_12 (PIN_INPUT_PULLUP  | MUX_MODE7) /* P8-12 (GPIO1_12) OD1 */
                        BONE_P8_05 (PIN_INPUT_PULLUP  | MUX_MODE7) /* P8-5 (GPIO1_2) OD2 */
                        BONE_P8_06 (PIN_INPUT_PULLUP  | MUX_MODE7) /* P8-6 (GPIO1_3) OD3 */
                        BONE_P8_11 (PIN_INPUT_PULLUP  | MUX_MODE7) /* P8-11 (GPIO1_13) OD4 */
                    >;
            };
       };
  };
};

